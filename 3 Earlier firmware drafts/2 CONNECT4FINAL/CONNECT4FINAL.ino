#include <Arduino.h>
#include <esp_camera.h>
#include <Adafruit_NeoPixel.h>
#include <vector>

// =================================================================================
// 1. TENSORFLOW LITE MICRO INCLUDES
// =================================================================================
#include "tensorflow/lite/micro/micro_mutable_op_resolver.h"
#include "tensorflow/lite/micro/micro_interpreter.h"
#include "tensorflow/lite/schema/schema_generated.h"

// =================================================================================
// 2. CONFIGURATION & PIN DEFINITIONS
// =================================================================================
// XIAO ESP32S3 Sense Camera Pins
#define PWDN_GPIO_NUM     -1
#define RESET_GPIO_NUM    -1
#define XCLK_GPIO_NUM     10
#define SIOD_GPIO_NUM     40
#define SIOC_GPIO_NUM     39
#define Y9_GPIO_NUM       48
#define Y8_GPIO_NUM       11
#define Y7_GPIO_NUM       12
#define Y6_GPIO_NUM       14
#define Y5_GPIO_NUM       16
#define Y4_GPIO_NUM       18
#define Y3_GPIO_NUM       17
#define Y2_GPIO_NUM       15
#define VSYNC_GPIO_NUM    38
#define HREF_GPIO_NUM     47
#define PCLK_GPIO_NUM     13

#define LED_PIN           D0 // Data Pin for LED Matrix
#define BUTTON_PIN        D1 // Button to trigger AI move
#define NUMPIXELS         64

// Model Settings
#define IMG_WIDTH         128
#define IMG_HEIGHT        128
#define IMG_CHANNELS      3
#define NUM_CLASSES       3   // 0=Empty, 1=Red, 2=Blue

// =================================================================================
// 3. MODELS (VISION & PREDICTION)
// =================================================================================

// --- MODEL 1: VISION MODEL (TFLite) ---
// PLACEHOLDER: Replace this array with your actual converted .tflite model hex!
// This model takes (1, 128, 128, 3) int8 image and outputs (1, 64, 3) int8 classification.
// UPDATED: Added alignas(16) to prevent LoadProhibited crashes due to misalignment
alignas(16) const unsigned char g_model_vision[] = {
0x1c, 0x00, 0x00, 0x00, 0x54, 0x46, 0x4c, 0x33, 0x14, 0x00, 0x20, 0x00, 
0x1c, 0x00, 0x18, 0x00, 0x14, 0x00, 0x10, 0x00, 0x0c, 0x00, 0x00, 0x00, 
0x08, 0x00, 0x04, 0x00, 0x14, 0x00, 0x00, 0x00, 0x1c, 0x00, 0x00, 0x00, 
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0x00, 0x00, 0x00, 0x03, 
};

// --- MODEL 2: MOVE PREDICTION (Heuristic AI) ---
int evaluateBoard(uint8_t board[8][8], int piece) {
    int score = 0;
    return score; 
}

// Heuristic AI to pick the best column
// Returns 0-7 for the column index, or -1 if full
int predictBestMove(uint8_t board[8][8], int colHeights[8], int aiColor) {
    Serial.println("DEBUG: predictBestMove() called");
    int bestCol = -1;
    int maxScore = -10000;

    // Iterate through all possible columns
    for (int col = 0; col < 8; col++) {
        if (colHeights[col] >= 8) {
             Serial.printf("DEBUG: Col %d is full, skipping\n", col);
             continue; // Column full
        }

        // Score based on centrality (Center columns are better in Connect 4)
        int score = 0;
        if (col == 3 || col == 4) score += 5;
        if (col == 2 || col == 5) score += 2;
        
        // Randomness to make it feel "alive"
        int randVal = random(0, 3);
        score += randVal;
        
        Serial.printf("DEBUG: Evaluating Col %d: Base Score=%d, Random=%d, Total=%d\n", col, score - randVal, randVal, score);

        if (score > maxScore) {
            maxScore = score;
            bestCol = col;
        }
    }
    
    // Fallback if no valid move found via score
    if (bestCol == -1) {
        Serial.println("DEBUG: No best move found via score, looking for any valid move");
        for(int i=0; i<8; i++) if(colHeights[i] < 8) {
             Serial.printf("DEBUG: Fallback selected col %d\n", i);
             return i;
        }
    }
    
    Serial.printf("DEBUG: predictBestMove returning %d\n", bestCol);
    return bestCol;
}

// =================================================================================
// 4. GLOBALS & OBJECTS
// =================================================================================
Adafruit_NeoPixel pixels(NUMPIXELS, LED_PIN, NEO_GRB + NEO_KHZ800);

// TFLM Globals
const tflite::Model* model = nullptr;
tflite::MicroInterpreter* interpreter = nullptr;
TfLiteTensor* input_tensor = nullptr;
TfLiteTensor* output_tensor = nullptr;

// Tensor Arena: Needs to be large enough for activations
// We allocate this in PSRAM (SPIRAM) in setup() because it won't fit in standard RAM.
uint8_t* tensor_arena = nullptr;
// NOTE: If your model crashes, try reducing this size slightly or verify PSRAM is actually enabled.
// 3MB is a lot; if PSRAM fails, malloc(3MB) on internal RAM (300KB) will definitely crash.
const int kArenaSize = 2 * 1024 * 1024; // Reduced to 2MB to be safer

// Game State
uint8_t boardState[8][8]; // 0=Empty, 1=Red, 2=Blue
int colHeights[8];
bool isButtonHeld = false; // Declared globally here

// =================================================================================
// 5. HELPER FUNCTIONS
// =================================================================================

// Function to initialize the camera
bool setupCamera() {
  camera_config_t config;
  config.ledc_channel = LEDC_CHANNEL_0;
  config.ledc_timer = LEDC_TIMER_0;
  config.pin_d0 = Y2_GPIO_NUM;
  config.pin_d1 = Y3_GPIO_NUM;
  config.pin_d2 = Y4_GPIO_NUM;
  config.pin_d3 = Y5_GPIO_NUM;
  config.pin_d4 = Y6_GPIO_NUM;
  config.pin_d5 = Y7_GPIO_NUM;
  config.pin_d6 = Y8_GPIO_NUM;
  config.pin_d7 = Y9_GPIO_NUM;
  config.pin_xclk = XCLK_GPIO_NUM;
  config.pin_pclk = PCLK_GPIO_NUM;
  config.pin_vsync = VSYNC_GPIO_NUM;
  config.pin_href = HREF_GPIO_NUM;
  config.pin_sscb_sda = SIOD_GPIO_NUM;
  config.pin_sscb_scl = SIOC_GPIO_NUM;
  config.pin_pwdn = PWDN_GPIO_NUM;
  config.pin_reset = RESET_GPIO_NUM;
  config.xclk_freq_hz = 20000000;
  config.pixel_format = PIXFORMAT_RGB565; // Capture RGB
  config.frame_size = FRAMESIZE_QVGA;     // 320x240
  config.jpeg_quality = 12;
  config.fb_count = 1;

  esp_err_t err = esp_camera_init(&config);
  if (err != ESP_OK) {
    Serial.printf("Camera init failed with error 0x%x", err);
    return false;
  }
  return true;
}

// Convert 565 RGB to INT8 for Quantized Model
void processImageToModelInput(camera_fb_t* fb) {
    Serial.println("DEBUG: Processing Image to Model Input...");
    if (input_tensor == nullptr) {
        Serial.println("ERROR: input_tensor is null!");
        return;
    }

    // Get input tensor parameters for quantization
    // These values tell us how to convert real float values to int8
    float input_scale = input_tensor->params.scale;
    int32_t input_zero_point = input_tensor->params.zero_point;

    // Get pointer to input data (int8_t for quantized model)
    int8_t* input_data = input_tensor->data.int8;

    int src_width = fb->width;
    int src_height = fb->height;
    int crop_size = (src_width < src_height) ? src_width : src_height; 
    int start_x = (src_width - crop_size) / 2;
    int start_y = (src_height - crop_size) / 2;

    for (int y = 0; y < IMG_HEIGHT; y++) {
        for (int x = 0; x < IMG_WIDTH; x++) {
            int src_x = start_x + (x * crop_size / IMG_WIDTH);
            int src_y = start_y + (y * crop_size / IMG_HEIGHT);
            int src_idx = (src_y * src_width + src_x) * 2;

            uint8_t low = fb->buf[src_idx];
            uint8_t high = fb->buf[src_idx + 1];
            uint16_t pixel = (high << 8) | low;

            // Extract RGB (0-255 range)
            uint8_t r = (pixel >> 11) & 0x1F; r = (r * 255) / 31;
            uint8_t g = (pixel >> 5) & 0x3F;  g = (g * 255) / 63;
            uint8_t b = pixel & 0x1F;         b = (b * 255) / 31;

            // Convert 0-255 RGB to 0.0-1.0 Float, then to Int8
            // Formula: Quantized = (Real_Value / Scale) + Zero_Point
            
            float r_norm = r / 255.0f;
            float g_norm = g / 255.0f;
            float b_norm = b / 255.0f;

            int tensor_idx = (y * IMG_WIDTH + x) * IMG_CHANNELS;

            input_data[tensor_idx + 0] = (int8_t)(r_norm / input_scale + input_zero_point);
            input_data[tensor_idx + 1] = (int8_t)(g_norm / input_scale + input_zero_point);
            input_data[tensor_idx + 2] = (int8_t)(b_norm / input_scale + input_zero_point);
        }
    }
    Serial.println("DEBUG: Image processing complete.");
}

void setZigZagPixel(int col, int row, uint32_t color) {
    int pixelIndex;
    if (row % 2 == 0) {
        pixelIndex = (row * 8) + col;
    } else {
        pixelIndex = (row * 8) + (7 - col);
    }
    pixels.setPixelColor(pixelIndex, color);
}

void updatePhysicalBoard() {
    Serial.println("DEBUG: Updating Physical LED Matrix...");
    pixels.clear();
    // We also recalculate column heights here to ensure AI has correct data
    for(int c=0; c<8; c++) {
        colHeights[c] = 0; 
        for(int r=0; r<8; r++) {
            uint8_t cell = boardState[c][r];
            if(cell == 1) { // Red
                setZigZagPixel(c, r, pixels.Color(150, 0, 0));
                colHeights[c]++;
            } else if (cell == 2) { // Blue (AI)
                setZigZagPixel(c, r, pixels.Color(0, 0, 150));
                colHeights[c]++;
            } else {
                setZigZagPixel(c, r, pixels.Color(0, 0, 0));
            }
        }
    }
    pixels.show();
    Serial.println("DEBUG: LEDs updated.");
}

int getColumnFromVoltage() {
    pinMode(BUTTON_PIN, INPUT_PULLDOWN);
    delay(1);
    int reading = analogRead(BUTTON_PIN);
    // Add debug print to see raw values
    // Serial.printf("Button ADC: %d\n", reading); 
    
    int col = -1;
    // Thresholds from your original code
    if (reading > 3500) col = 7;
    else if (reading > 2900) col = 6;
    else if (reading > 2500) col = 5;
    else if (reading > 2100) col = 4;
    else if (reading > 1600) col = 3;
    else if (reading > 1100) col = 2;
    else if (reading > 750) col = 1;
    else if (reading > 300) col = 0;
    
    if (col != -1) {
         Serial.printf("DEBUG: Analog Read: %d -> Mapped to Column: %d\n", reading, col);
    }
    return col;
}

// =================================================================================
// 6. SETUP
// =================================================================================
void setup() {
  // Small delay to allow Serial to connect before potential crash
  delay(3000); 
  Serial.begin(115200);
  Serial.println("DEBUG: Starting Setup...");
  
  // 1. Initialize Hardware
  pixels.begin();
  pixels.setBrightness(20);
  pixels.show();
  analogReadResolution(12);
  
  if (!setupCamera()) {
    Serial.println("Camera Init Failed!");
    while(1);
  }
  Serial.println("Camera Initialized.");

  // 2. PSRAM Check
  if(psramFound()){
      Serial.printf("PSRAM Found. Size: %d bytes. Free: %d bytes.\n", ESP.getPsramSize(), ESP.getFreePsram());
      tensor_arena = (uint8_t*)ps_malloc(kArenaSize);
      if (tensor_arena == nullptr) {
          Serial.println("CRITICAL ERROR: ps_malloc failed to allocate arena! Out of PSRAM?");
          while(1);
      }
      Serial.println("Arena allocated in PSRAM");
  } else {
      Serial.println("CRITICAL WARNING: PSRAM not found! Attempting malloc in SRAM...");
      // If model is large, this WILL crash
      tensor_arena = (uint8_t*)malloc(kArenaSize);
      if (tensor_arena == nullptr) {
          Serial.println("CRITICAL ERROR: malloc failed! System out of memory.");
          while(1);
      }
  }

  // 3. Check Model Array
  Serial.printf("DEBUG: g_model_vision address: %p\n", g_model_vision);
  Serial.printf("DEBUG: First 8 bytes of model: %02X %02X %02X %02X %02X %02X %02X %02X\n", 
                g_model_vision[0], g_model_vision[1], g_model_vision[2], g_model_vision[3],
                g_model_vision[4], g_model_vision[5], g_model_vision[6], g_model_vision[7]);

  // Map the model
  model = tflite::GetModel(g_model_vision);
  if (model->version() != TFLITE_SCHEMA_VERSION) {
    Serial.printf("Model schema version mismatch! Expected: %d, Got: %d\n", TFLITE_SCHEMA_VERSION, model->version());
    while(1);
  }
  Serial.println("DEBUG: Model Loaded");

  // Setup Ops Resolver
  // INCREASED SIZE to accommodate extra quantized ops
  static tflite::MicroMutableOpResolver<25> op_resolver; // Increased from 20 to 25
  
  // Standard Ops
  op_resolver.AddConv2D();
  op_resolver.AddMaxPool2D();
  op_resolver.AddFullyConnected();
  op_resolver.AddSoftmax();
  op_resolver.AddReshape();
  op_resolver.AddRelu();
  
  // REQUIRED for Quantized Models:
  op_resolver.AddQuantize();
  op_resolver.AddDequantize();
  
  // Helper Ops often inserted by TFLite Converter
  op_resolver.AddPad(); 
  op_resolver.AddAdd();
  op_resolver.AddMul();
  op_resolver.AddSub();
  op_resolver.AddMean(); 
  op_resolver.AddConcatenation();
  
  // **FIX FOR YOUR ERROR:**
  op_resolver.AddShape();        // <--- This was the missing op
  op_resolver.AddStridedSlice(); // Commonly appears with Shape/Reshape
  op_resolver.AddPack();         // Sometimes used in reshaping
  op_resolver.AddSplit();        // Sometimes used in reshaping

  // Build Interpreter
  static tflite::MicroInterpreter static_interpreter(
      model, op_resolver, tensor_arena, kArenaSize);
  interpreter = &static_interpreter;

  // Allocate Tensors
  Serial.println("DEBUG: Attempting to allocate tensors...");
  TfLiteStatus allocate_status = interpreter->AllocateTensors();
  if (allocate_status != kTfLiteOk) {
    Serial.println("AllocateTensors() failed!");
    // Since we don't have error reporter, try printing to check if model loaded
    if (model == nullptr) Serial.println("Model is null");
    while(1);
  }
  Serial.println("DEBUG: Tensors Allocated Successfully");

  input_tensor = interpreter->input(0);
  output_tensor = interpreter->output(0);
  
  Serial.println("AI System Ready. Waiting for Red move...");
}

// =================================================================================
// 7. MAIN LOOP
// =================================================================================
void loop() {
    int btn = getColumnFromVoltage();
    
    if (btn != -1 && !isButtonHeld) {
        Serial.printf("DEBUG: Initial button detect col %d. Debouncing...\n", btn);
        // Debounce
        delay(50);
        int verifiedColumn = getColumnFromVoltage();
        Serial.printf("DEBUG: Verified column: %d\n", verifiedColumn);
        
        if (verifiedColumn == btn) {
            isButtonHeld = true;
            Serial.printf("Player Move Detected in Column: %d\n", verifiedColumn);
            
            // --- 1. INSTANT PLAYER FEEDBACK (Manual Logic) ---
            int manualPlacedRow = -1;
            if (colHeights[verifiedColumn] < 8) {
                manualPlacedRow = colHeights[verifiedColumn];
                boardState[verifiedColumn][manualPlacedRow] = 1; // 1 = Red (Player)
                Serial.printf("DEBUG: Manually adding Red piece at Col %d, Row %d\n", verifiedColumn, manualPlacedRow);
            } else {
                Serial.println("DEBUG: Column is full! Cannot add piece.");
            }
            
            // Update the physical board IMMEDIATELY so player sees their move
            updatePhysicalBoard();
            
            // Wait a brief moment to simulate the piece dropping
            delay(500);

            // --- 2. VISION MODEL: VERIFICATION ---
            Serial.println("Scanning Board with Camera...");
            camera_fb_t* fb = esp_camera_fb_get();
            if (!fb) {
                Serial.println("Camera capture failed");
                return;
            }
            Serial.println("DEBUG: Frame captured");

            // Preprocess and fill input tensor
            processImageToModelInput(fb);
            esp_camera_fb_return(fb);
            Serial.println("DEBUG: Frame buffer returned");

            // Run Inference
            Serial.println("DEBUG: Invoking Interpreter...");
            if (interpreter->Invoke() != kTfLiteOk) {
                Serial.println("Inference failed");
                return;
            }
            Serial.println("DEBUG: Inference Success");

            // --- 3. VISION MODEL: SYNC STATE ---
            // Output shape: (1, 64, 3) INT8
            int8_t* out_data = output_tensor->data.int8;
            
            Serial.println("DEBUG: Updating Board State from Vision Model...");
            // We update boardState with what the AI *actually* sees
            // This corrects any manual mistakes or missed pieces
            for (int i = 0; i < 64; i++) {
                int8_t p0 = out_data[i*3 + 0]; // Empty
                int8_t p1 = out_data[i*3 + 1]; // Red
                int8_t p2 = out_data[i*3 + 2]; // Blue
                
                int r = i / 8;
                int c = i % 8;

                if (p0 > p1 && p0 > p2) boardState[c][r] = 0;
                else if (p1 > p0 && p1 > p2) boardState[c][r] = 1;
                else boardState[c][r] = 2;
            }
            
            // --- 3b. CORRECTION LOGIC ---
            // If we manually placed a piece, but the model says it's Empty (0),
            // we override the model. The LED helps the user, but the camera might miss it.
            if (manualPlacedRow != -1) {
                 if (boardState[verifiedColumn][manualPlacedRow] == 0) {
                      Serial.printf("DEBUG: Model missed the move at [%d][%d]. Forcing Red piece.\n", verifiedColumn, manualPlacedRow);
                      boardState[verifiedColumn][manualPlacedRow] = 1;
                 }
            }
            
            Serial.println("DEBUG: Board State Synced.");
            
            // Update board again in case model made corrections (or we forced correction)
            updatePhysicalBoard(); 
            
            // --- 4. MOVE PREDICTION MODEL (GAME AI) ---
            Serial.println("Calculating AI Move...");
            int aiMoveCol = predictBestMove(boardState, colHeights, 2);
            
            if (aiMoveCol != -1) {
                Serial.printf("AI chooses column: %d\n", aiMoveCol);
                int row = colHeights[aiMoveCol];
                if(row < 8) {
                    boardState[aiMoveCol][row] = 2; // Place Blue
                    Serial.printf("DEBUG: AI placing Blue piece at Col %d, Row %d\n", aiMoveCol, row);
                    updatePhysicalBoard(); // Update again after AI move
                } else {
                    Serial.println("DEBUG: AI attempted to place in full column");
                }
            } else {
                Serial.println("AI could not find a move (Board full?)");
            }
        } else {
            Serial.println("DEBUG: Debounce failed (signal unstable)");
        }
    } else if (btn == -1) {
        if (isButtonHeld) {
             Serial.println("DEBUG: Button released.");
        }
        isButtonHeld = false;
    }
    
    delay(10);
}